## boards/shields/nice_view_harjot/Kconfig.shield
```kconfig
# Copyright (c) 2024 Harjot Singh
# SPDX-License-Identifier: MIT

config SHIELD_NICE_VIEW_HARJOT
    def_bool $(shields_list_contains,nice_view_harjot)
```
